/*
 * Spreadtrum SP9860g SoC DTS file
 *
 * Copyright (C) 2016, Spreadtrum Communications Inc.
 *
 * This file is licensed under a dual GPLv2 or X11 license.
 */

#include "sc9850s.dtsi"

/* Add or override sc9850s nodes and properties with sc9860g new features */


