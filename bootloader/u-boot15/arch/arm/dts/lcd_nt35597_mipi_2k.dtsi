/ { lcds {
	lcd_nt35597_mipi_2k: lcd97@97 {

		work-mode = <1>;
		bpp = <24>;
		lane-number = <4>;

		hsync-pol = <0>;
		vsync-pol = <0>;
		de-pol = <0>;
		te-pol = <0>;
		color_mode_pol = <1>;
		shut_down_pol = <1>;
		dsc_compression = <1>;

		fps = <60>;
		direction = <0>;
		simu_width = <480>;
		simu_height = <854>;
		panel_name = "lcd_nt35597_mipi_2k";

		power-on-sequence = <
					171  1  10
					172  1  20
					126  1  20
					126  0  20
					126  1  120
					>;
		power-off-sequence = <
					172  0  20
					171  0  10
					126  0  20
					>;

		init-data = [
			23 00 00 02 FF 20
			23 00 00 02 FB 01
			23 00 00 02 00 01
			23 00 00 02 01 55
			23 00 00 02 02 45
			23 00 00 02 05 40
			23 00 00 02 06 9a
			23 00 00 02 07 9E
			23 00 00 02 11 91
			23 00 00 02 13 00
			23 00 00 02 0B 9B
			23 00 00 02 0C 9B
			23 00 00 02 0E a4
			23 00 00 02 0F a0
			23 00 00 02 30 00
			23 00 00 02 56 00
			23 00 00 02 58 00
			23 00 00 02 59 00
			23 00 00 02 5A 00
			23 00 00 02 5B 00
			23 00 00 02 5C 00
			23 00 00 02 5D 00
			23 00 00 02 5E 00
			23 00 00 02 5F 00
			23 00 00 02 60 80
			23 00 00 02 61 04
			23 00 00 02 62 00
			23 00 00 02 63 03
			23 00 00 02 68 03
			23 00 00 02 6D 66
			23 00 00 02 72 31
			23 00 00 02 FF 20
			23 00 00 02 FB 01
			23 00 00 02 75 00
			23 00 00 02 76 00
			23 00 00 02 77 00
			23 00 00 02 78 46
			23 00 00 02 79 00
			23 00 00 02 7A 8B
			23 00 00 02 7B 00
			23 00 00 02 7C B5
			23 00 00 02 7D 00
			23 00 00 02 7E D5
			23 00 00 02 7F 00
			23 00 00 02 80 EE
			23 00 00 02 81 01
			23 00 00 02 82 03
			23 00 00 02 83 01
			23 00 00 02 84 16
			23 00 00 02 85 01
			23 00 00 02 86 26
			23 00 00 02 87 01
			23 00 00 02 88 59
			23 00 00 02 89 01
			23 00 00 02 8A 7F
			23 00 00 02 8B 01
			23 00 00 02 8C B7
			23 00 00 02 8D 01
			23 00 00 02 8E E0
			23 00 00 02 8F 02
			23 00 00 02 90 18
			23 00 00 02 91 02
			23 00 00 02 92 47
			23 00 00 02 93 02
			23 00 00 02 94 49
			23 00 00 02 95 02
			23 00 00 02 96 77
			23 00 00 02 97 02
			23 00 00 02 98 A8
			23 00 00 02 99 02
			23 00 00 02 9A C3
			23 00 00 02 9B 02
			23 00 00 02 9C E2
			23 00 00 02 9D 02
			23 00 00 02 9E F7
			23 00 00 02 9F 03
			23 00 00 02 A0 16
			23 00 00 02 A2 03
			23 00 00 02 A3 21
			23 00 00 02 A4 03
			23 00 00 02 A5 2E
			23 00 00 02 A6 03
			23 00 00 02 A7 3D
			23 00 00 02 A9 03
			23 00 00 02 AA 50
			23 00 00 02 AB 03
			23 00 00 02 AC 6A
			23 00 00 02 AD 03
			23 00 00 02 AE 90
			23 00 00 02 AF 03
			23 00 00 02 B0 C4
			23 00 00 02 B1 03
			23 00 00 02 B2 D1
			23 00 00 02 B3 00
			23 00 00 02 B4 00
			23 00 00 02 B5 00
			23 00 00 02 B6 46
			23 00 00 02 B7 00
			23 00 00 02 B8 8B
			23 00 00 02 B9 00
			23 00 00 02 BA B5
			23 00 00 02 BB 00
			23 00 00 02 BC D5
			23 00 00 02 BD 00
			23 00 00 02 BE EE
			23 00 00 02 BF 01
			23 00 00 02 C0 03
			23 00 00 02 C1 01
			23 00 00 02 C2 16
			23 00 00 02 C3 01
			23 00 00 02 C4 26
			23 00 00 02 C5 01
			23 00 00 02 C6 59
			23 00 00 02 C7 01
			23 00 00 02 C8 7F
			23 00 00 02 C9 01
			23 00 00 02 CA B7
			23 00 00 02 CB 01
			23 00 00 02 CC E0
			23 00 00 02 CD 02
			23 00 00 02 CE 18
			23 00 00 02 CF 02
			23 00 00 02 D0 47
			23 00 00 02 D1 02
			23 00 00 02 D2 49
			23 00 00 02 D3 02
			23 00 00 02 D4 77
			23 00 00 02 D5 02
			23 00 00 02 D6 A8
			23 00 00 02 D7 02
			23 00 00 02 D8 C3
			23 00 00 02 D9 02
			23 00 00 02 DA E2
			23 00 00 02 DB 02
			23 00 00 02 DC F7
			23 00 00 02 DD 03
			23 00 00 02 DE 16
			23 00 00 02 DF 03
			23 00 00 02 E0 21
			23 00 00 02 E1 03
			23 00 00 02 E2 2E
			23 00 00 02 E3 03
			23 00 00 02 E4 3D
			23 00 00 02 E5 03
			23 00 00 02 E6 50
			23 00 00 02 E7 03
			23 00 00 02 E8 6A
			23 00 00 02 E9 03
			23 00 00 02 EA 90
			23 00 00 02 EB 03
			23 00 00 02 EC C4
			23 00 00 02 ED 03
			23 00 00 02 EE D1
			23 00 00 02 EF 00
			23 00 00 02 F0 00
			23 00 00 02 F1 00
			23 00 00 02 F2 46
			23 00 00 02 F3 00
			23 00 00 02 F4 8B
			23 00 00 02 F5 00
			23 00 00 02 F6 B5
			23 00 00 02 F7 00
			23 00 00 02 F8 D5
			23 00 00 02 F9 00
			23 00 00 02 FA EE
			23 00 00 02 FF 21
			23 00 00 02 FB 01
			23 00 00 02 00 01
			23 00 00 02 01 03
			23 00 00 02 02 01
			23 00 00 02 03 16
			23 00 00 02 04 01
			23 00 00 02 05 26
			23 00 00 02 06 01
			23 00 00 02 07 59
			23 00 00 02 08 01
			23 00 00 02 09 7F
			23 00 00 02 0A 01
			23 00 00 02 0B B7
			23 00 00 02 0C 01
			23 00 00 02 0D E0
			23 00 00 02 0E 02
			23 00 00 02 0F 18
			23 00 00 02 10 02
			23 00 00 02 11 47
			23 00 00 02 12 02
			23 00 00 02 13 49
			23 00 00 02 14 02
			23 00 00 02 15 77
			23 00 00 02 16 02
			23 00 00 02 17 A8
			23 00 00 02 18 02
			23 00 00 02 19 C3
			23 00 00 02 1A 02
			23 00 00 02 1B E2
			23 00 00 02 1C 02
			23 00 00 02 1D F7
			23 00 00 02 1E 03
			23 00 00 02 1F 16
			23 00 00 02 20 03
			23 00 00 02 21 21
			23 00 00 02 22 03
			23 00 00 02 23 2E
			23 00 00 02 24 03
			23 00 00 02 25 3D
			23 00 00 02 26 03
			23 00 00 02 27 50
			23 00 00 02 28 03
			23 00 00 02 29 6A
			23 00 00 02 2A 03
			23 00 00 02 2B 90
			23 00 00 02 2D 03
			23 00 00 02 2F C4
			23 00 00 02 30 03
			23 00 00 02 31 D1
			23 00 00 02 32 00
			23 00 00 02 33 00
			23 00 00 02 34 00
			23 00 00 02 35 46
			23 00 00 02 36 00
			23 00 00 02 37 8B
			23 00 00 02 38 00
			23 00 00 02 39 B5
			23 00 00 02 3A 00
			23 00 00 02 3B D5
			23 00 00 02 3D 00
			23 00 00 02 3F EE
			23 00 00 02 40 01
			23 00 00 02 41 03
			23 00 00 02 42 01
			23 00 00 02 43 16
			23 00 00 02 44 01
			23 00 00 02 45 26
			23 00 00 02 46 01
			23 00 00 02 47 59
			23 00 00 02 48 01
			23 00 00 02 49 7F
			23 00 00 02 4A 01
			23 00 00 02 4B B7
			23 00 00 02 4C 01
			23 00 00 02 4D E0
			23 00 00 02 4E 02
			23 00 00 02 4F 18
			23 00 00 02 50 02
			23 00 00 02 51 47
			23 00 00 02 52 02
			23 00 00 02 53 49
			23 00 00 02 54 02
			23 00 00 02 55 77
			23 00 00 02 56 02
			23 00 00 02 58 A8
			23 00 00 02 59 02
			23 00 00 02 5A C3
			23 00 00 02 5B 02
			23 00 00 02 5C E2
			23 00 00 02 5D 02
			23 00 00 02 5E F7
			23 00 00 02 5F 03
			23 00 00 02 60 16
			23 00 00 02 61 03
			23 00 00 02 62 21
			23 00 00 02 63 03
			23 00 00 02 64 2E
			23 00 00 02 65 03
			23 00 00 02 66 3D
			23 00 00 02 67 03
			23 00 00 02 68 50
			23 00 00 02 69 03
			23 00 00 02 6A 6A
			23 00 00 02 6B 03
			23 00 00 02 6C 90
			23 00 00 02 6D 03
			23 00 00 02 6E C4
			23 00 00 02 6F 03
			23 00 00 02 70 D1
			23 00 00 02 71 00
			23 00 00 02 72 00
			23 00 00 02 73 00
			23 00 00 02 74 46
			23 00 00 02 75 00
			23 00 00 02 76 8B
			23 00 00 02 77 00
			23 00 00 02 78 B5
			23 00 00 02 79 00
			23 00 00 02 7A D5
			23 00 00 02 7B 00
			23 00 00 02 7C EE
			23 00 00 02 7D 01
			23 00 00 02 7E 03
			23 00 00 02 7F 01
			23 00 00 02 80 16
			23 00 00 02 81 01
			23 00 00 02 82 26
			23 00 00 02 83 01
			23 00 00 02 84 59
			23 00 00 02 85 01
			23 00 00 02 86 7F
			23 00 00 02 87 01
			23 00 00 02 88 B7
			23 00 00 02 89 01
			23 00 00 02 8A E0
			23 00 00 02 8B 02
			23 00 00 02 8C 18
			23 00 00 02 8D 02
			23 00 00 02 8E 47
			23 00 00 02 8F 02
			23 00 00 02 90 49
			23 00 00 02 91 02
			23 00 00 02 92 77
			23 00 00 02 93 02
			23 00 00 02 94 A8
			23 00 00 02 95 02
			23 00 00 02 96 C3
			23 00 00 02 97 02
			23 00 00 02 98 E2
			23 00 00 02 99 02
			23 00 00 02 9A F7
			23 00 00 02 9B 03
			23 00 00 02 9C 16
			23 00 00 02 9D 03
			23 00 00 02 9E 21
			23 00 00 02 9F 03
			23 00 00 02 A0 2E
			23 00 00 02 A2 03
			23 00 00 02 A3 3D
			23 00 00 02 A4 03
			23 00 00 02 A5 50
			23 00 00 02 A6 03
			23 00 00 02 A7 6A
			23 00 00 02 A9 03
			23 00 00 02 AA 90
			23 00 00 02 AB 03
			23 00 00 02 AC C4
			23 00 00 02 AD 03
			23 00 00 02 AE D1
			23 00 00 02 AF 00
			23 00 00 02 B0 00
			23 00 00 02 B1 00
			23 00 00 02 B2 46
			23 00 00 02 B3 00
			23 00 00 02 B4 8B
			23 00 00 02 B5 00
			23 00 00 02 B6 B5
			23 00 00 02 B7 00
			23 00 00 02 B8 D5
			23 00 00 02 B9 00
			23 00 00 02 BA EE
			23 00 00 02 BB 01
			23 00 00 02 BC 03
			23 00 00 02 BD 01
			23 00 00 02 BE 16
			23 00 00 02 BF 01
			23 00 00 02 C0 26
			23 00 00 02 C1 01
			23 00 00 02 C2 59
			23 00 00 02 C3 01
			23 00 00 02 C4 7F
			23 00 00 02 C5 01
			23 00 00 02 C6 B7
			23 00 00 02 C7 01
			23 00 00 02 C8 E0
			23 00 00 02 C9 02
			23 00 00 02 CA 18
			23 00 00 02 CB 02
			23 00 00 02 CC 47
			23 00 00 02 CD 02
			23 00 00 02 CE 49
			23 00 00 02 CF 02
			23 00 00 02 D0 77
			23 00 00 02 D1 02
			23 00 00 02 D2 A8
			23 00 00 02 D3 02
			23 00 00 02 D4 C3
			23 00 00 02 D5 02
			23 00 00 02 D6 E2
			23 00 00 02 D7 02
			23 00 00 02 D8 F7
			23 00 00 02 D9 03
			23 00 00 02 DA 16
			23 00 00 02 DB 03
			23 00 00 02 DC 21
			23 00 00 02 DD 03
			23 00 00 02 DE 2E
			23 00 00 02 DF 03
			23 00 00 02 E0 3D
			23 00 00 02 E1 03
			23 00 00 02 E2 50
			23 00 00 02 E3 03
			23 00 00 02 E4 6A
			23 00 00 02 E5 03
			23 00 00 02 E6 90
			23 00 00 02 E7 03
			23 00 00 02 E8 C4
			23 00 00 02 E9 03
			23 00 00 02 EA D1
			23 00 00 02 ff E0
			23 00 00 02 fb 01
			23 00 00 02 3f 08
			23 00 00 02 6B 3D
			23 00 00 02 6C 3D
			23 00 00 02 6D 3D
			23 00 00 02 6E 3D
			23 00 00 02 6F 3D
			23 00 00 02 35 02
			23 00 00 02 36 72
			23 00 00 02 37 10
			23 00 00 02 FF 24
			23 00 00 02 FB 01
			23 00 00 02 00 0C
			23 00 00 02 01 0B
			23 00 00 02 02 0F
			23 00 00 02 03 08
			23 00 00 02 04 07
			23 00 00 02 05 01
			23 00 00 02 06 00
			23 00 00 02 07 00
			23 00 00 02 08 00
			23 00 00 02 09 00
			23 00 00 02 0A 00
			23 00 00 02 0B 17
			23 00 00 02 0C 00
			23 00 00 02 0D 15
			23 00 00 02 0E 00
			23 00 00 02 0F 13
			23 00 00 02 10 0C
			23 00 00 02 11 0B
			23 00 00 02 12 0F
			23 00 00 02 13 08
			23 00 00 02 14 07
			23 00 00 02 15 01
			23 00 00 02 16 00
			23 00 00 02 17 00
			23 00 00 02 18 00
			23 00 00 02 19 00
			23 00 00 02 1A 00
			23 00 00 02 1B 17
			23 00 00 02 1C 00
			23 00 00 02 1D 15
			23 00 00 02 1E 00
			23 00 00 02 1F 13
			23 00 00 02 20 09
			23 00 00 02 21 03
			23 00 00 02 22 03
			23 00 00 02 23 01
			23 00 00 02 24 72
			23 00 00 02 25 3D
			23 00 00 02 26 01
			23 00 00 02 27 72
			23 00 00 02 29 38
			23 00 00 02 2A 2B
			23 00 00 02 3F 04
			23 00 00 02 40 12
			23 00 00 02 41 e9
			23 00 00 02 42 01
			23 00 00 02 43 02
			23 00 00 02 44 70
			23 00 00 02 45 00
			23 00 00 02 46 2d
			23 00 00 02 47 08
			23 00 00 02 48 02
			23 00 00 02 49 70
			23 00 00 02 5B 00
			23 00 00 02 5F 75
			23 00 00 02 63 04
			23 00 00 02 67 70
			23 00 00 02 b5 15
			23 00 00 02 72 02
			23 00 00 02 7A 00
			23 00 00 02 7B A2
			23 00 00 02 7C D8
			23 00 00 02 7D 50
			23 00 00 02 74 0D
			23 00 00 02 75 19
			23 00 00 02 7F 19
			23 00 00 02 86 5B
			23 00 00 02 87 39
			23 00 00 02 88 1b
			23 00 00 02 89 39
			23 00 00 02 8C 11
			23 00 00 02 B3 00
			23 00 00 02 B4 01
			23 00 00 02 B5 00
			23 00 00 02 78 00
			23 00 00 02 79 00
			23 00 00 02 80 00
			23 00 00 02 83 00
			23 00 00 02 93 10
			23 00 00 02 94 10
			23 00 00 02 8A 33
			23 00 00 02 8B F4
			23 00 00 02 9B 0F
			23 00 00 02 9d 30
			23 00 00 02 EC 00
			23 00 00 02 FF 22
			23 00 00 02 Fb 01
			23 00 00 02 A2 20
			23 00 00 02 FF 28
			23 00 00 02 Fb 01
			23 00 00 02 7A 02
			23 00 00 02 FF 10
			23 00 00 02 Fb 01
			39 00 00 06 3B 03 08 08 40 40
			23 00 00 02 35 00
			39 00 00 11 C1 09 20 0A 00 01 DB 02 68 E4 BD 00 0A 00 0A 00 08
			39 00 00 03 C2 12 18
			23 00 00 02 C0 03
			23 00 00 02 35 00
			23 00 00 02 BB 03
			13 78 00 01 11
			13 64 00 01 29
			];
		sleep-in = [
			13 0A 00 01 28
			13 78 00 01 10
			];
		sleep-out = [
			13 78 00 01 11
			13 64 00 01 29
			];
		esd-check = [
			37 00 00 02 01 00
			];
		read-id = [
			37 00 00 02 02 00
			];

		display-timings {
			clock-frequency = <600000>;
			hactive = <1440>;
			vactive = <2560>;
			hback-porch = <64>;
			hfront-porch = <70>;
			vback-porch = <6>;
			vfront-porch = <10>;
			hsync-len = <20>;
			vsync-len = <2>;
			hsync-active = <0>;
			vsync-active = <0>;
			de-active = <0>;
			pixelclk-active = <1>;
		};
	};
};};

