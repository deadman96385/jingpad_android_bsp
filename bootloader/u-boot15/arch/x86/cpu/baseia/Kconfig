## bootloader/u-boot15/board/spreadtrum/isharkl/Kconfig
```kconfig
if TARGET_ISHARKL

config SYS_BOARD
	default "isharkl"

config SYS_VENDOR
	default "spreadtrum"

config SYS_SOC
	default "sprd-soc"

config SYS_CONFIG_NAME
	default "isharkl"

config SYS_TEXT_BASE
	default 0x7f000000

config BOARD_SPECIFIC_OPTIONS # dummy
	def_bool y
	select BULLHILL

config DEFAULT_DEVICE_TREE
	string "Board Device Tree Source (dts) file"
	default "isharkl"
	help
	  This option selects the board Device Tree Source (dts) file in
	  arch/x86/dts/ directory to be used to build U-Boot for coreboot.

config SYS_CAR_ADDR
	hex "Board specific Cache-As-RAM (CAR) address"
	default 0x19200000
	help
	  This option specifies the board specific Cache-As-RAM (CAR) address.

config SYS_CAR_SIZE
	hex "Board specific Cache-As-RAM (CAR) size"
	default 0x4000
	help
	  This option specifies the board specific Cache-As-RAM (CAR) size.

endif
```

## bootloader/u-boot15/board/spreadtrum/j1fpga/Kconfig
```kconfig
if TARGET_J1FPGA

config SYS_BOARD
	default "j1fpga"

config SYS_VENDOR
	default "spreadtrum"

config SYS_SOC
	default "sharklj1"

config SYS_CONFIG_NAME
	default "j1fpga"

config SYS_TEXT_BASE
	default 0x9f000000

config SMT_VALUE
	hex
	default 0x00
	help
	  The value to decide whether enable smt

endif
```

## bootloader/u-boot15/board/spreadtrum/j1vdk/Kconfig
```kconfig
if TARGET_J1VDK

config SYS_BOARD
	default "j1vdk"

config SYS_VENDOR
	default "spreadtrum"

config SYS_SOC
	default "sharklj1"

config SYS_CONFIG_NAME
	default "j1vdk"

config SYS_TEXT_BASE
	default 0x9f000000

config SMT_VALUE
	hex
	default 0x00
	help
	  The value to decide whether enable smt

endif
```

## bootloader/u-boot15/board/spreadtrum/pike2/Kconfig
```kconfig
if TARGET_PIKE2

config SYS_BOARD
	default "pike2"

config SYS_VENDOR
	default "spreadtrum"

config SYS_SOC
	default "pike2"

config SYS_CONFIG_NAME
	default "pike2"

config SYS_TEXT_BASE
	default 0x9f000000

endif
```

## bootloader/u-boot15/board/spreadtrum/sl8541e_1h10/Kconfig
```kconfig
if TARGET_SL8541E_1H10

config SYS_BOARD
	default "sl8541e_1h10"

config SYS_VENDOR
	default "spreadtrum"

config SYS_SOC
	default "sharkle"

config SYS_CONFIG_NAME
	default "sl8541e_1h10"

config SYS_TEXT_BASE
	default 0x9f000000

endif
```

## bootloader/u-boot15/board/spreadtrum/sp7731e_1h10/Kconfig
```kconfig
if TARGET_SP7731E_1H10

config SYS_BOARD
	default "sp7731e_1h10"

config SYS_VENDOR
	default "spreadtrum"

config SYS_SOC
	default "pike2"

config SYS_CONFIG_NAME
	default "sp7731e_1h10"

config SYS_TEXT_BASE
	default 0x9f000000

endif
```

## bootloader/u-boot15/board/spreadtrum/sp7731e_1h20/Kconfig
```kconfig
if TARGET_SP7731E_1H20

config SYS_BOARD
	default "sp7731e_1h20"

config SYS_VENDOR
	default "spreadtrum"

config SYS_SOC
	default "pike2"

config SYS_CONFIG_NAME
	default "sp7731e_1h20"

config SYS_TEXT_BASE
	default 0x9f000000

endif
```

## bootloader/u-boot15/board/spreadtrum/sp7731e_fpga/Kconfig
```kconfig
if TARGET_SP7731E_FPGA

config SYS_BOARD
	default "sp7731e_fpga"

config SYS_VENDOR
	default "spreadtrum"

config SYS_SOC
	default "pike2"

config SYS_CONFIG_NAME
	default "sp7731e_fpga"

config SYS_TEXT_BASE
	default 0x9f000000

endif
```

## bootloader/u-boot15/board/spreadtrum/sp9650_haps/Kconfig
```kconfig
if TARGET_SP9650_HAPS

config SYS_BOARD
	default "sp9650_haps"

config SYS_VENDOR
	default "spreadtrum"

config SYS_SOC
	default "orca"

config SYS_CONFIG_NAME
	default "sp9650_haps"

config SYS_TEXT_BASE
	default 0x9f000000

endif
```

## bootloader/u-boot15/board/spreadtrum/sp9820e_13c10/Kconfig
```kconfig
if TARGET_SP9820E_13C10

config SYS_BOARD
	default "sp9820e_13c10"

config SYS_VENDOR
	default "spreadtrum"

config SYS_SOC
	default "sharkle"

config SYS_CONFIG_NAME
	default "sp9820e_13c10"

config SYS_TEXT_BASE
	default 0x9f000000

endif
```

## bootloader/u-boot15/board/spreadtrum/sp9820e_1h10/Kconfig
```kconfig
if TARGET_SP9820E_1H10

config SYS_BOARD
	default "sp9820e_1h10"

config SYS_VENDOR
	default "spreadtrum"

config SYS_SOC
	default "sharkle"

config SYS_CONFIG_NAME
	default "sp9820e_1h10"

config SYS_TEXT_BASE
	default 0x9f000000

endif
```

## bootloader/u-boot15/board/spreadtrum/sp9820e_2c10/Kconfig
```kconfig
if TARGET_SP9820E_2C10

config SYS_BOARD
	default "sp9820e_2c10"

config SYS_VENDOR
	default "spreadtrum"

config SYS_SOC
	default "sharkle"

config SYS_CONFIG_NAME
	default "sp9820e_2c10"

config SYS_TEXT_BASE
	default 0x9f000000

endif
```

## bootloader/u-boot15/board/spreadtrum/sp9820e_5c10/Kconfig
```kconfig
if TARGET_SP9820E_5C10

config SYS_BOARD
	default "sp9820e_5c10"

config SYS_VENDOR
	default "spreadtrum"

config SYS_SOC
	default "sharkle"

config SYS_CONFIG_NAME
	default "sp9820e_5c10"

config SYS_TEXT_BASE
	default 0x9f000000

endif
```

## bootloader/u-boot15/board/spreadtrum/sp9820e_64b/Kconfig
```kconfig
if TARGET_SP9820E_64B

config SYS_BOARD
	default "sp9820e_64b"

config SYS_VENDOR
	default "spreadtrum"

config SYS_SOC
	default "sharkle"

config SYS_CONFIG_NAME
	default "sp9820e_64b"

config SYS_TEXT_BASE
	default 0x9f000000

endif
```

## bootloader/u-boot15/board/spreadtrum/sp9830a-7h10_ga1/Kconfig
```kconfig
if TARGET_SP9830A_7H10_GA1

config SYS_BOARD
	default "sp9830a-7h10_ga1"

config SYS_VENDOR
	default "spreadtrum"

config SYS_SOC
	default "sc9630"

config SYS_CONFIG_NAME
	default "sp9830a-7h10_ga1"

config SYS_TEXT_BASE
	default 0x9f000000

endif
```

## bootloader/u-boot15/board/spreadtrum/sp9832e_10c10_32b/Kconfig
```kconfig
if TARGET_SP9832E_10C10_32B

config SYS_BOARD
	default "sp9832e_10c10_32b"

config SYS_VENDOR
	default "spreadtrum"

config SYS_SOC
	default "sharkle"

config SYS_CONFIG_NAME
	default "sp9832e_10c10_32b"

config SYS_TEXT_BASE
	default 0x9f000000

endif
```

## bootloader/u-boot15/board/spreadtrum/sp9832e_10c20/Kconfig
```kconfig
if TARGET_SP9832E_10C20

config SYS_BOARD
	default "sp9832e_10c20"

config SYS_VENDOR
	default "spreadtrum"

config SYS_SOC
	default "sharkle"

config SYS_CONFIG_NAME
	default "sp9832e_10c20"

config SYS_TEXT_BASE
	default 0x9f000000

endif
```

## bootloader/u-boot15/board/spreadtrum/sp9832e_1h10/Kconfig
```kconfig
if TARGET_SP9832E_1H10

config SYS_BOARD
	default "sp9832e_1h10"

config SYS_VENDOR
	default "spreadtrum"

config SYS_SOC
	default "sharkle"

config SYS_CONFIG_NAME
	default "sp9832e_1h10"

config SYS_TEXT_BASE
	default 0x9f000000

endif
```

## bootloader/u-boot15/board/spreadtrum/sp9832ep_haps/Kconfig
```kconfig
if TARGET_SP9832EP_HAPS

config SYS_BOARD
	default "sp9832ep_haps"

config SYS_VENDOR
	default "spreadtrum"

config SYS_SOC
	default "sharkler"

config SYS_CONFIG_NAME
	default "sp9832ep_haps"

config SYS_TEXT_BASE
	default 0x9f000000

endif
```

## bootloader/u-boot15/board/spreadtrum/sp9833zebu/Kconfig
```kconfig
if TARGET_SP9833ZEBU

config SYS_BOARD
	default "sp9833zebu"

config SYS_VENDOR
	default "spreadtrum"

config SYS_SOC
	default "sc9833"

config SYS_CONFIG_NAME
	default "sp9833zebu"

config SYS_TEXT_BASE
	default 0x9f000000

endif
```

## bootloader/u-boot15/board/spreadtrum/sp9835_haps/Kconfig
```kconfig
if TARGET_SP9835_HAPS

config SYS_BOARD
	default "sp9835_haps"

config SYS_VENDOR
	default "spreadtrum"

config SYS_SOC
	default "sharkle"

config SYS_CONFIG_NAME
	default "sp9835_haps"

config SYS_TEXT_BASE
	default 0x9f000000

endif
```

## bootloader/u-boot15/board/spreadtrum/sp9850e_1h10/Kconfig
```kconfig
if TARGET_SP9850E_1H10

config SYS_BOARD
	default "sp9850e_1h10"

config SYS_VENDOR
	default "spreadtrum"

config SYS_SOC
	default "sharkle"

config SYS_CONFIG_NAME
	default "sp9850e_1h10"

config SYS_TEXT_BASE
	default 0x9f000000

endif
```

## bootloader/u-boot15/board/spreadtrum/sp9850ka_1h10/Kconfig
```kconfig
if TARGET_SP9850KA_1H10

config SYS_BOARD
	default "sp9850ka_1h10"

config SYS_VENDOR
	default "spreadtrum"

config SYS_SOC
	default "sc9833"

config SYS_CONFIG_NAME
	string "Board Config Header file"
	default "sp9850ka_1h10"
	help
	  This option selects the board config file in
	  include/configs/ directory to be used to build U-Boot.

config SYS_TEXT_BASE
	default 0x9f000000

endif
```
