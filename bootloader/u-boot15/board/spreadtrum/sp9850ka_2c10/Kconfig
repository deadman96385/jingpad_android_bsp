## bootloader/u-boot15/board/spreadtrum/sp9850ka_2c10/Kconfig
```kconfig
if TARGET_SP9850KA_2C10

config SYS_BOARD
	default "sp9850ka_2c10"

config SYS_VENDOR
	default "spreadtrum"

config SYS_SOC
	default "sc9833"

config SYS_CONFIG_NAME
	default "sp9850ka_2c10"

config SYS_TEXT_BASE
	default 0x9f000000

endif
```

## bootloader/u-boot15/board/spreadtrum/sp9850ka_2c30/Kconfig
```kconfig
if TARGET_SP9850KA_2C30

config SYS_BOARD
	default "sp9850ka_2c30"

config SYS_VENDOR
	default "spreadtrum"

config SYS_SOC
	default "sc9833"

config SYS_CONFIG_NAME
	default "sp9850ka_2c30"

config SYS_TEXT_BASE
	default 0x9f000000

endif
```

## bootloader/u-boot15/board/spreadtrum/sp9850kh_1h10/Kconfig
```kconfig
if TARGET_SP9850KH_1H10

config SYS_BOARD
	default "sp9850kh_1h10"

config SYS_VENDOR
	default "spreadtrum"

config SYS_SOC
	default "sharklj1"

config SYS_CONFIG_NAME
	default "sp9850kh_1h10"

config SYS_TEXT_BASE
	default 0x9f000000

config SMT_VALUE
	hex
	default 0x00
	help
	  The value to decide whether enable smt

endif
```

## bootloader/u-boot15/board/spreadtrum/sp9850kh_2c20/Kconfig
```kconfig
if TARGET_SP9850KH_2C20

config SYS_BOARD
	default "sp9850kh_2c20"

config SYS_VENDOR
	default "spreadtrum"

config SYS_SOC
	default "sharklj1"

config SYS_CONFIG_NAME
	default "sp9850kh_2c20"

config SYS_TEXT_BASE
	default 0x9f000000

config SMT_VALUE
	hex
	default 0x00
	help
	  The value to decide whether enable smt

endif
```

## bootloader/u-boot15/board/spreadtrum/sp9850s_2h10_5m/Kconfig
```kconfig
if TARGET_SP9850S_2H10_5M

config SYS_BOARD
	default "sp9850s_2h10_5m"

config SYS_VENDOR
	default "spreadtrum"

config SYS_SOC
	default "whale2"

config SYS_CONFIG_NAME
	default "sp9850s_2h10_5m"

config SYS_TEXT_BASE
	default 0x9f000000

endif
```

## bootloader/u-boot15/board/spreadtrum/sp9853i_2h10/Kconfig
```kconfig
if TARGET_SP9853I_2H10

config SYS_BOARD
	default "sp9853i_2h10"

config SYS_VENDOR
	default "spreadtrum"

config SYS_SOC
	default "iwhale"

config SYS_CONFIG_NAME
	string "Board Config Header file"
	default "sp9853i_2h10"
	help
	  This option selects the board config file in
	  include/configs/ directory to be used to build U-Boot.

config SYS_TEXT_BASE
	default 0x5ec00000

config BOARD_SPECIFIC_OPTIONS # dummy
	def_bool y
	select BULLHILL

config DEFAULT_DEVICE_TREE
	string "Board Device Tree Source (dts) file"
	default "sp9853i_2h10"
	help
	  This option selects the board Device Tree Source (dts) file in
	  arch/x86/dts/ directory to be used to build U-Boot.

config SYS_CAR_ADDR
	hex "Board specific Cache-As-RAM (CAR) address"
	default 0x5f000000
	help
	  This option specifies the board specific Cache-As-RAM (CAR) address.

config SYS_CAR_SIZE
	hex "Board specific Cache-As-RAM (CAR) size"
	default 0x4000
	help
	  This option specifies the board specific Cache-As-RAM (CAR) size.

endif
```

## bootloader/u-boot15/board/spreadtrum/sp9855a_haps/Kconfig
```kconfig
if TARGET_SP9855A_HAPS

config SYS_BOARD
	default "sp9855a_haps"

config SYS_VENDOR
	default "spreadtrum"

config SYS_SOC
	default "sharkl3"

config SYS_CONFIG_NAME
	default "sp9855a_haps"

config SYS_TEXT_BASE
	default 0x9f000000

endif
```

## bootloader/u-boot15/board/spreadtrum/sp9860g_1h10_al/Kconfig
```kconfig
if TARGET_SP9860G_1H10_AL

config SYS_BOARD
	default "sp9860g_1h10_al"

config SYS_VENDOR
	default "spreadtrum"

config SYS_SOC
	default "whale2"

config SYS_CONFIG_NAME
	default "sp9860g_1h10_al"

config SYS_TEXT_BASE
	default 0x9f000000

endif
```

## bootloader/u-boot15/board/spreadtrum/sp9860g_4h10_5m/Kconfig
```kconfig
if TARGET_SP9860G_4H10_5M

config SYS_BOARD
	default "sp9860g_4h10_5m"

config SYS_VENDOR
	default "spreadtrum"

config SYS_SOC
	default "whale2"

config SYS_CONFIG_NAME
	default "sp9860g_4h10_5m"

config SYS_TEXT_BASE
	default 0x9f000000

endif
```

## bootloader/u-boot15/board/spreadtrum/sp9861e_2h10/Kconfig
```kconfig
if TARGET_SP9861E_2H10

config SYS_BOARD
	default "sp9861e_2h10"

config SYS_VENDOR
	default "spreadtrum"

config SYS_SOC
	default "iwhale"

config SYS_CONFIG_NAME
	string "Board Config Header file"
	default "sp9861e_2h10"
	help
	  This option selects the board config file in
	  include/configs/ directory to be used to build U-Boot.

config SYS_TEXT_BASE
	default 0x7f000000

config BOARD_SPECIFIC_OPTIONS # dummy
	def_bool y
	select BULLHILL

config DEFAULT_DEVICE_TREE
	string "Board Device Tree Source (dts) file"
	default "iwhale2"
	help
	  This option selects the board Device Tree Source (dts) file in
	  arch/x86/dts/ directory to be used to build U-Boot.

config SYS_CAR_ADDR
	hex "Board specific Cache-As-RAM (CAR) address"
	default 0x19200000
	help
	  This option specifies the board specific Cache-As-RAM (CAR) address.

config SYS_CAR_SIZE
	hex "Board specific Cache-As-RAM (CAR) size"
	default 0x4000
	help
	  This option specifies the board specific Cache-As-RAM (CAR) size.

endif
```

## bootloader/u-boot15/board/spreadtrum/sp9863a_1h10_32b/Kconfig
```kconfig
if TARGET_SP9863A_1H10_32B

config SYS_BOARD
	default "sp9863a_1h10_32b"

config SYS_VENDOR
	default "spreadtrum"

config SYS_SOC
	default "sharkl3"

config SYS_CONFIG_NAME
	default "sp9863a_1h10_32b"

config SYS_TEXT_BASE
	default 0x9f000000

endif
```

## bootloader/u-boot15/board/spreadtrum/sp9863a_3c10_32b/Kconfig
```kconfig
if TARGET_SP9863A_3C10_32B

config SYS_BOARD
	default "sp9863a_3c10_32b"

config SYS_VENDOR
	default "spreadtrum"

config SYS_SOC
	default "sharkl3"

config SYS_CONFIG_NAME
	default "sp9863a_3c10_32b"

config SYS_TEXT_BASE
	default 0x9f000000

endif
```

## bootloader/u-boot15/board/spreadtrum/sp9863a_3h10/Kconfig
```kconfig
if TARGET_SP9863A_3H10

config SYS_BOARD
	default "sp9863a_3h10"

config SYS_VENDOR
	default "spreadtrum"

config SYS_SOC
	default "sharkl3"

config SYS_CONFIG_NAME
	default "sp9863a_3h10"

config SYS_TEXT_BASE
	default 0x9f000000

endif
```

## bootloader/u-boot15/board/spreadtrum/ss_whale2_j7/Kconfig
```kconfig
if TARGET_SS_WHALE2_J7

config SYS_BOARD
	default "ss_whale2_j7"

config SYS_VENDOR
	default "spreadtrum"

config SYS_SOC
	default "whale2"

config SYS_CONFIG_NAME
	default "ss_whale2_j7"

config SYS_TEXT_BASE
	default 0x9f000000

endif
```

## bootloader/u-boot15/board/spreadtrum/ss_whale2_jigboard/Kconfig
```kconfig
if TARGET_SS_WHALE2_JIGBOARD

config SYS_BOARD
	default "ss_whale2_jigboard"

config SYS_VENDOR
	default "spreadtrum"

config SYS_SOC
	default "whale2"

config SYS_CONFIG_NAME
	default "ss_whale2_jigboard"

config SYS_TEXT_BASE
	default 0x9f000000

endif
```

## bootloader/u-boot15/board/spreadtrum/ud710_20c11/Kconfig
```kconfig
if TARGET_UD710_20C11

config SYS_BOARD
	default "ud710_20c11"

config SYS_VENDOR
	default "spreadtrum"

config SYS_SOC
	default "roc1"

config SYS_CONFIG_NAME
	default "ud710_20c11"

config SYS_TEXT_BASE
	default 0x9f000000

endif
```

## bootloader/u-boot15/board/spreadtrum/ud710_2c11/Kconfig
```kconfig
if TARGET_UD710_2C11

config SYS_BOARD
	default "ud710_2c11"

config SYS_VENDOR
	default "spreadtrum"

config SYS_SOC
	default "roc1"

config SYS_CONFIG_NAME
	default "ud710_2c11"

config SYS_TEXT_BASE
	default 0x9f000000

endif
```

## bootloader/u-boot15/board/spreadtrum/ud710_2h10/Kconfig
```kconfig
if TARGET_UD710_2H10

config SYS_BOARD
	default "ud710_2h10"

config SYS_VENDOR
	default "spreadtrum"

config SYS_SOC
	default "roc1"

config SYS_CONFIG_NAME
	default "ud710_2h10"

config SYS_TEXT_BASE
	default 0x9f000000

endif
```

## bootloader/u-boot15/board/spreadtrum/ud710_3h10/Kconfig
```kconfig
if TARGET_UD710_3H10

config SYS_BOARD
	default "ud710_3h10"

config SYS_VENDOR
	default "spreadtrum"

config SYS_SOC
	default "roc1"

config SYS_CONFIG_NAME
	default "ud710_3h10"

config SYS_TEXT_BASE
	default 0x9f000000

endif
```

## bootloader/u-boot15/board/spreadtrum/ud710_3h10u/Kconfig
```kconfig
if TARGET_UD710_3H10U

config SYS_BOARD
	default "ud710_3h10u"

config SYS_VENDOR
	default "spreadtrum"

config SYS_SOC
	default "roc1"

config SYS_CONFIG_NAME
	default "ud710_3h10u"

config SYS_TEXT_BASE
	default 0x9f000000

endif
```

## bootloader/u-boot15/board/spreadtrum/ud710_haps/Kconfig
```kconfig
if TARGET_UD710_HAPS

config SYS_BOARD
	default "ud710_haps"

config SYS_VENDOR
	default "spreadtrum"

config SYS_SOC
	default "roc1"

config SYS_CONFIG_NAME
	default "ud710_haps"

config SYS_TEXT_BASE
	default 0x9f000000

endif
```

## bootloader/u-boot15/board/spreadtrum/ud710_orca_haps/Kconfig
```kconfig
if TARGET_UD710_ORCA_HAPS

config SYS_BOARD
	default "ud710_orca_haps"

config SYS_VENDOR
	default "spreadtrum"

config SYS_SOC
	default "roc1"

config SYS_CONFIG_NAME
	default "ud710_orca_haps"

config SYS_TEXT_BASE
	default 0x9f000000

endif
```

## bootloader/u-boot15/board/spreadtrum/udx710_1h10/Kconfig
```kconfig
if TARGET_UDX710_1H10

config SYS_BOARD
	default "udx710_1h10"

config SYS_VENDOR
	default "spreadtrum"

config SYS_SOC
	default "orca"

config SYS_CONFIG_NAME
	default "udx710_1h10"

config SYS_TEXT_BASE
	default 0x9f000000

endif
```

## bootloader/u-boot15/board/spreadtrum/udx710_2h10/Kconfig
```kconfig
if TARGET_UDX710_2H10

config SYS_BOARD
	default "udx710_2h10"

config SYS_VENDOR
	default "spreadtrum"

config SYS_SOC
	default "orca"

config SYS_CONFIG_NAME
	default "udx710_2h10"

config SYS_TEXT_BASE
	default 0x9f000000

endif
```

## bootloader/u-boot15/board/spreadtrum/udx710_3h10_32b/Kconfig
```kconfig
if TARGET_UDX710_3H10_32B

config SYS_BOARD
	default "udx710_3h10_32b"

config SYS_VENDOR
	default "spreadtrum"

config SYS_SOC
	default "orca"

config SYS_CONFIG_NAME
	default "udx710_3h10_32b"

config SYS_TEXT_BASE
	default 0x9f000000

endif
```
