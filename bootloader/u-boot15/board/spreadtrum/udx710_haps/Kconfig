## bootloader/u-boot15/board/spreadtrum/udx710_haps/Kconfig
```kconfig
if TARGET_UDX710_HAPS

config SYS_BOARD
	default "udx710_haps"

config SYS_VENDOR
	default "spreadtrum"

config SYS_SOC
	default "orca"

config SYS_CONFIG_NAME
	default "udx710_haps"

config SYS_TEXT_BASE
	default 0x9f000000

endif
```

## bootloader/u-boot15/board/spreadtrum/ums312_1h10/Kconfig
```kconfig
if TARGET_UMS312_1H10

config SYS_BOARD
	default "ums312_1h10"

config SYS_VENDOR
	default "spreadtrum"

config SYS_SOC
	default "sharkl5"

config SYS_CONFIG_NAME
	default "ums312_1h10"

config SYS_TEXT_BASE
	default 0x9f000000

endif
```

## bootloader/u-boot15/board/spreadtrum/ums312_1h10_32b/Kconfig
```kconfig
if TARGET_UMS312_1H10_32B

config SYS_BOARD
	default "ums312_1h10_32b"

config SYS_VENDOR
	default "spreadtrum"

config SYS_SOC
	default "sharkl5"

config SYS_CONFIG_NAME
	default "ums312_1h10_32b"

config SYS_TEXT_BASE
	default 0x9f000000

endif
```

## bootloader/u-boot15/board/spreadtrum/ums312_3h10_4pro/Kconfig
```kconfig
if TARGET_UMS312_3H10_4PRO

config SYS_BOARD
	default "ums312_3h10_4pro"

config SYS_VENDOR
	default "spreadtrum"

config SYS_SOC
	default "sharkl5"

config SYS_CONFIG_NAME
	default "ums312_3h10_4pro"

config SYS_TEXT_BASE
	default 0x9f000000

endif
```

## bootloader/u-boot15/board/spreadtrum/ums510_haps/Kconfig
```kconfig
if TARGET_UMS510_HAPS

config SYS_BOARD
	default "ums510_haps"

config SYS_VENDOR
	default "spreadtrum"

config SYS_SOC
	default "sharkl5"

config SYS_CONFIG_NAME
	default "ums510_haps"

config SYS_TEXT_BASE
	default 0x9f000000

endif
```

## bootloader/u-boot15/board/spreadtrum/ums512_1h10/Kconfig
```kconfig
if TARGET_UMS512_1H10

config SYS_BOARD
	default "ums512_1h10"

config SYS_VENDOR
	default "spreadtrum"

config SYS_SOC
	default "sharkl5pro"

config SYS_CONFIG_NAME
	default "ums512_1h10"

config SYS_TEXT_BASE
	default 0x9f000000

endif
```

## bootloader/u-boot15/board/spreadtrum/ums518_haps/Kconfig
```kconfig
if TARGET_UMS518_HAPS

config SYS_BOARD
	default "ums518_haps"

config SYS_VENDOR
	default "spreadtrum"

config SYS_SOC
	default "sharkl5pro"

config SYS_CONFIG_NAME
	default "ums518_haps"

config SYS_TEXT_BASE
	default 0x9f000000

endif
```

## bootloader/u-boot15/board/spreadtrum/ums518_haps_bkd/Kconfig
```kconfig
if TARGET_UMS518_HAPS_BKD

config SYS_BOARD
	default "ums518_haps_bkd"

config SYS_VENDOR
	default "spreadtrum"

config SYS_SOC
	default "sharkl5pro"

config SYS_CONFIG_NAME
	default "ums518_haps_bkd"

config SYS_TEXT_BASE
	default 0x9f000000

endif
```

## bootloader/u-boot15/board/spreadtrum/ums518_zebu/Kconfig
```kconfig
if TARGET_UMS518_ZEBU

config SYS_BOARD
	default "ums518_zebu"

config SYS_VENDOR
	default "spreadtrum"

config SYS_SOC
	default "sharkl5pro"

config SYS_CONFIG_NAME
	default "ums518_zebu"

config SYS_TEXT_BASE
	default 0x9f000000

endif
```

## bootloader/u-boot15/board/spreadtrum/ums7520_haps/Kconfig
```kconfig
if TARGET_UMS7520_HAPS

config SYS_BOARD
	default "ums7520_haps"

config SYS_VENDOR
	default "spreadtrum"

config SYS_SOC
	default "qogirn6pro"

config SYS_CONFIG_NAME
	default "ums7520_haps"

config SYS_TEXT_BASE
	default 0x9f000000

endif
```

## bootloader/u-boot15/board/spreadtrum/ums7520_zebu/Kconfig
```kconfig
if TARGET_UMS7520_ZEBU

config SYS_BOARD
	default "ums7520_zebu"

config SYS_VENDOR
	default "spreadtrum"

config SYS_SOC
	default "qogirn6pro"

config SYS_CONFIG_NAME
	default "ums7520_zebu"

config SYS_TEXT_BASE
	default 0x9f000000

endif
```

## bootloader/u-boot15/configs/j1fpga_choose_smt_defconfig
```kconfig
CONFIG_ARM=y
CONFIG_VENDOR_SPRD=y
CONFIG_TARGET_J1FPGA=y
CONFIG_SMT_VALUE=0x10
CONFIG_OF_CONTROL=y
# CONFIG_CMD_IMLS is not set
# CONFIG_CMD_NET is not set
```

## bootloader/u-boot15/configs/pike2_vp_defconfig
```kconfig
CONFIG_ARM=y
CONFIG_VENDOR_SPRD=y
CONFIG_TARGET_PIKE2=y
CONFIG_OF_CONTROL=y
# CONFIG_CMD_IMLS is not set
# CONFIG_CMD_NET is not set
```

## bootloader/u-boot15/configs/pike2_wcn_defconfig
```kconfig
CONFIG_ARM=y
CONFIG_VENDOR_SPRD=y
CONFIG_TARGET_PIKE2=y
CONFIG_SPRD_WCN=y
#CONFIG_OF_CONTROL=y
# CONFIG_CMD_IMLS is not set
# CONFIG_CMD_NET is not set
```

## bootloader/u-boot15/configs/sp7731e_1h10_defconfig
```kconfig
CONFIG_ARM=y
CONFIG_VENDOR_SPRD=y
CONFIG_TARGET_SP7731E_1H10=y
CONFIG_OF_CONTROL=y
CONFIG_OF_LIBFDT_OVERLAY=y
# CONFIG_CMD_IMLS is not set
# CONFIG_CMD_NET is not set
```

## bootloader/u-boot15/configs/sp7731e_fpga_defconfig
```kconfig
CONFIG_ARM=y
CONFIG_VENDOR_SPRD=y
CONFIG_TARGET_SP7731E_FPGA=y
#CONFIG_OF_CONTROL is not set
# CONFIG_CMD_IMLS is not set
# CONFIG_CMD_NET is not set
```

## bootloader/u-boot15/configs/sp9830a-7h10_ga1_defconfig
```kconfig
CONFIG_ARM=y
CONFIG_VENDOR_SPRD=y
CONFIG_TARGET_SP9830A_7H10_GA1=y
# CONFIG_CMD_IMLS is not set
```

## bootloader/u-boot15/configs/sp9833zebu_defconfig
```kconfig
CONFIG_ARM=y
CONFIG_VENDOR_SPRD=y
CONFIG_TARGET_SP9833ZEBU=y
# CONFIG_CMD_IMLS is not set
```

## bootloader/u-boot15/configs/sp9850e_1h10_defconfig
```kconfig
CONFIG_ARM=y
CONFIG_VENDOR_SPRD=y
CONFIG_TARGET_SP9850E_1H10=y
CONFIG_OF_CONTROL=y
# CONFIG_CMD_BDI is not set
# CONFIG_CMD_ECHO is not set
# CONFIG_CMD_FLASH is not set
# CONFIG_CMD_IMI is not set
# CONFIG_CMD_IMLS is not set
# CONFIG_CMD_MEMORY is not set
# CONFIG_CMD_NET is not set
# CONFIG_CMD_RUN is not set
# CONFIG_CMD_SAVEENV is not set
# CONFIG_CMD_SOURCE is not set
```

## bootloader/u-boot15/configs/sp9850ka_1h10_n_defconfig
```kconfig
CONFIG_ARM=y
CONFIG_SYS_CONFIG_NAME="sp9850ka_1h10_n"
CONFIG_VENDOR_SPRD=y
CONFIG_TARGET_SP9850KA_1H10=y
CONFIG_OF_CONTROL=y
# CONFIG_CMD_IMLS is not set
# CONFIG_CMD_NET is not set
```

## bootloader/u-boot15/configs/sp9850ka_2c20_defconfig
```kconfig
CONFIG_ARM=y
CONFIG_VENDOR_SPRD=y
CONFIG_TARGET_SP9850KA_2C20=y
CONFIG_OF_CONTROL=y
# CONFIG_CMD_IMLS is not set
# CONFIG_CMD_NET is not set
```

## bootloader/u-boot15/configs/sp9850kh_2c20_defconfig
```kconfig
CONFIG_ARM=y
CONFIG_VENDOR_SPRD=y
CONFIG_TARGET_SP9850KH_2C20=y
CONFIG_SMT_VALUE=0x01
CONFIG_OF_CONTROL=y
# CONFIG_CMD_IMLS is not set
# CONFIG_CMD_NET is not set
```

## bootloader/u-boot15/configs/sp9853i_3c10_vmm_defconfig
```kconfig
CONFIG_X86=y
CONFIG_SYS_CONFIG_NAME="sp9853i_3c10_vmm"
CONFIG_VENDOR_SPRD=y
CONFIG_TSC_FREQ_IN_MHZ=1872
CONFIG_BASEIA_S3=y
CONFIG_INTEL_MICROCODE=y
CONFIG_DEFAULT_DEVICE_TREE="sp9853i_3c10_vmm"
CONFIG_MAX_CPUS=8
CONFIG_SMP=y
CONFIG_TARGET_SP9853I_3C10=y
CONFIG_TSC_CALIBRATION_BYPASS=y
CONFIG_CMD_CPU=y
# CONFIG_CMD_IMLS is not set
# CONFIG_CMD_FLASH is not set
# CONFIG_CMD_SETEXPR is not set
# CONFIG_CMD_NFS is not set
CONFIG_BOOTSTAGE=y
CONFIG_BOOTSTAGE_REPORT=y
CONFIG_CMD_BOOTSTAGE=y
CONFIG_OF_CONTROL=y
CONFIG_CPU=y
CONFIG_USE_PRIVATE_LIBGCC=y
CONFIG_SYS_VSNPRINTF=y
CONFIG_MOBILEVISOR=y
CONFIG_EMMC_BOOT=y
CONFIG_GENERIC_MMC=y
```

## bootloader/u-boot15/configs/sp9853i_fpga_vmm_defconfig
```kconfig
CONFIG_X86=y
CONFIG_VENDOR_SPRD=y
CONFIG_DEFAULT_DEVICE_TREE="sp9853i-vmm"
CONFIG_TARGET_SP9853I=y
CONFIG_SYS_TEXT_BASE=0x7ec00000
CONFIG_SYS_CAR_ADDR=0x7f000000
CONFIG_TSC_FREQ_IN_MHZ=3744
# CONFIG_BASEIA_S3 is not set
CONFIG_MAX_CPUS=8
CONFIG_TARGET_SP9853I_FPGA=y
CONFIG_TSC_CALIBRATION_BYPASS=y
CONFIG_CMD_CPU=y
# CONFIG_CMD_IMLS is not set
# CONFIG_CMD_FLASH is not set
# CONFIG_CMD_SETEXPR is not set
# CONFIG_CMD_NFS is not set
CONFIG_BOOTSTAGE=y
CONFIG_BOOTSTAGE_REPORT=y
CONFIG_CMD_BOOTSTAGE=y
CONFIG_OF_CONTROL=y
CONFIG_CPU=y
CONFIG_USE_PRIVATE_LIBGCC=y
CONFIG_SYS_VSNPRINTF=y
CONFIG_MOBILEVISOR=y
CONFIG_EMMC_BOOT=y
CONFIG_GENERIC_MMC=y
CONFIG_FPGA=y
```

## bootloader/u-boot15/configs/sp9861_ddr4g_singlechannel_vp_defconfig
```kconfig
CONFIG_X86=y
CONFIG_VENDOR_SPRD=y
CONFIG_TARGET_SP9861_VP=y
CONFIG_TSC_FREQ_IN_MHZ=3744
CONFIG_INTEL_MICROCODE=y
CONFIG_MAX_CPUS=8
CONFIG_SMP=y
CONFIG_SP9861_DDR4G=y
CONFIG_SP9861_DDR4G_SINGLE=y
CONFIG_TSC_CALIBRATION_BYPASS=y
CONFIG_CMD_CPU=y
# CONFIG_CMD_IMLS is not set
# CONFIG_CMD_FLASH is not set
# CONFIG_CMD_SETEXPR is not set
# CONFIG_CMD_NFS is not set
CONFIG_BOOTSTAGE=y
CONFIG_BOOTSTAGE_REPORT=y
CONFIG_CMD_BOOTSTAGE=y
CONFIG_OF_CONTROL=y
CONFIG_CPU=y
CONFIG_USE_PRIVATE_LIBGCC=y
CONFIG_SYS_VSNPRINTF=y
CONFIG_EMMC_BOOT=y
CONFIG_GENERIC_MMC=y
```
