## bootloader/u-boot15/configs/sp9861_fpga_ufs_vmm_defconfig
```kconfig
CONFIG_X86=y
CONFIG_SYS_CONFIG_NAME="sp9861_vmm"
CONFIG_VENDOR_SPRD=y
CONFIG_DEFAULT_DEVICE_TREE="sp9861_vmm_fpga"
CONFIG_TARGET_SP9861=y
CONFIG_TSC_FREQ_IN_MHZ=3744
CONFIG_MAX_CPUS=8
CONFIG_TSC_CALIBRATION_BYPASS=y
CONFIG_CMD_CPU=y
# CONFIG_CMD_IMLS is not set
# CONFIG_CMD_FLASH is not set
# CONFIG_CMD_SETEXPR is not set
# CONFIG_CMD_NFS is not set
CONFIG_BOOTSTAGE=y
CONFIG_BOOTSTAGE_REPORT=y
CONFIG_CMD_BOOTSTAGE=y
CONFIG_OF_CONTROL=y
CONFIG_CPU=y
CONFIG_USE_PRIVATE_LIBGCC=y
CONFIG_SYS_VSNPRINTF=y
CONFIG_TARGET_SP9861_FPGA=y
CONFIG_UFS=y
CONFIG_UFS_BOOT=y
```

## bootloader/u-boot15/configs/sp9861e_1h10_defconfig
```kconfig
CONFIG_X86=y
CONFIG_SYS_CONFIG_NAME="sp9861e_1h10"
CONFIG_VENDOR_SPRD=y
CONFIG_TARGET_SP9861E_1H10=y
CONFIG_DEFAULT_DEVICE_TREE="sp9861e_1h10"
CONFIG_SYS_TEXT_BASE=0x5ec00000
CONFIG_SYS_CAR_ADDR=0x5f000000
CONFIG_TSC_FREQ_IN_MHZ=2184
CONFIG_INTEL_MICROCODE=y
CONFIG_MAX_CPUS=8
CONFIG_SMP=y
CONFIG_EMMC_BOOT=y
CONFIG_GENERIC_MMC=y
CONFIG_TSC_CALIBRATION_BYPASS=y
CONFIG_CMD_CPU=y
# CONFIG_CMD_IMLS is not set
# CONFIG_CMD_FLASH is not set
# CONFIG_CMD_SETEXPR is not set
# CONFIG_CMD_NFS is not set
CONFIG_BOOTSTAGE=y
CONFIG_BOOTSTAGE_REPORT=y
CONFIG_CMD_BOOTSTAGE=y
CONFIG_OF_CONTROL=y
CONFIG_CPU=y
CONFIG_USE_PRIVATE_LIBGCC=y
CONFIG_SYS_VSNPRINTF=y
# CONFIG_CMD_NET is not set
```

## bootloader/u-boot15/configs/sp9861e_3h10_vmm_defconfig
```kconfig
CONFIG_X86=y
CONFIG_SYS_CONFIG_NAME="sp9861e_3h10_vmm"
CONFIG_VENDOR_SPRD=y
CONFIG_TARGET_SP9861E_3H10=y
CONFIG_DEFAULT_DEVICE_TREE="sp9861e_3h10_vmm"
CONFIG_SYS_TEXT_BASE=0x5ec00000
CONFIG_SYS_CAR_ADDR=0x5f000000
CONFIG_TSC_FREQ_IN_MHZ=2184
CONFIG_BASEIA_S3=y
CONFIG_INTEL_MICROCODE=y
CONFIG_MOBILEVISOR=y
CONFIG_MAX_CPUS=8
CONFIG_SMP=y
CONFIG_EMMC_BOOT=y
CONFIG_GENERIC_MMC=y
CONFIG_TSC_CALIBRATION_BYPASS=y
CONFIG_CMD_CPU=y
# CONFIG_CMD_IMLS is not set
# CONFIG_CMD_FLASH is not set
# CONFIG_CMD_SETEXPR is not set
# CONFIG_CMD_NFS is not set
CONFIG_BOOTSTAGE=y
CONFIG_BOOTSTAGE_REPORT=y
CONFIG_CMD_BOOTSTAGE=y
CONFIG_OF_CONTROL=y
CONFIG_CPU=y
CONFIG_USE_PRIVATE_LIBGCC=y
CONFIG_SYS_VSNPRINTF=y
```

## bootloader/u-boot15/configs/sp9863a_10c10_defconfig
```kconfig
CONFIG_ARM=y
CONFIG_VENDOR_SPRD=y
CONFIG_TARGET_SP9863A_10C10=y
CONFIG_OF_CONTROL=y
CONFIG_OF_LIBFDT_OVERLAY=y
#CONFIG_FPGA=y
# CONFIG_CMD_BDI is not set
# CONFIG_CMD_ECHO is not set
# CONFIG_CMD_FLASH is not set
# CONFIG_CMD_IMI is not set
# CONFIG_CMD_IMLS is not set
# CONFIG_CMD_MEMORY is not set
# CONFIG_CMD_NET is not set
# CONFIG_CMD_RUN is not set
# CONFIG_CMD_SAVEENV is not set
# CONFIG_CMD_SOURCE is not set
```

## bootloader/u-boot15/configs/udx710_3h10_32b_defconfig
```kconfig
CONFIG_ARM=y
CONFIG_VENDOR_SPRD=y
CONFIG_TARGET_UDX710_3H10_32B=y
CONFIG_OF_CONTROL=y
# CONFIG_FPGA is not set
# CONFIG_CMD_BDI is not set
# CONFIG_CMD_ECHO is not set
# CONFIG_CMD_FLASH is not set
# CONFIG_CMD_IMI is not set
# CONFIG_CMD_IMLS is not set
# CONFIG_CMD_MEMORY is not set
# CONFIG_CMD_NET is not set
# CONFIG_CMD_RUN is not set
# CONFIG_CMD_SAVEENV is not set
# CONFIG_CMD_SOURCE is not set
```

## kernel/kernel4.14/Documentation/devicetree/bindings/input/touchscreen/novatek-NVT-ts.txt
```
ptics TD4310 I2C touchscreen controller

Required properties:
- compatible:	"solomon,ssd20xx"
- gpios		The reset and interrupt GPIO number
- reg:		I2C slave address of the chip

Example nodes:

&i2c3 {
	/* ... */
	NVT-ts@01{
	compatible = "novatek,NVT-ts";
	reg = <0x01>;
	novatek,reset-gpio = <&ap_gpio 145 GPIO_ACTIVE_HIGH>;
	novatek,irq-gpio = <&ap_gpio 144 GPIO_ACTIVE_HIGH>;
	virtualkey = <80 1650 30 30
	240 1650 30 30
	400 1650 30 30>;
	TP_MAX_X = <720>;
	TP_MAX_Y = <1600>;
	};
	/* ... */
};
```

## kernel/kernel4.14/Documentation/devicetree/bindings/soc/sprd/sprd,orca-verify.txt
```
Spreadtrum verify bindings

This driver is soft logic,it is used to verify modem when kernel is ready,
it will use ap-efuse driver to read or write public efuse block,and it is
designed only for the project of orca.

Required properties:
- compatible: "sprd,orca-verify".
- nvmem-names: Should contain following entries:
	"ap-efuse" for match the name of efuse driver
- nvmem: Should contain the phandle for the entry in nvmem-names.

Example:

	sprd-verify {
		compatible = "sprd,orca-verify";
		nvmem-names = "ap-efuse";
		nvmem = <&ap_efuse>;
	};
```

## kernel/kernel4.14/drivers/hwtracing/coresight/phy/Kconfig
```kconfig
#
# Physical Layer Coresight PHY driver configuration
#
menu "Coresight Physical Layer drivers"

config CORESIGHT_PHY
	select EXTCON
	def_bool n

config SPRD_ORCA_CORESIGHT_PHY
	tristate "Spreadtrum ORCA CORESIGHT PHY Driver"
	select CORESIGHT_PHY
	help
	  Enable this to support ORCA CORESIGHT PHY that is part of SOC.

endmenu
```

## kernel/kernel4.14/drivers/input/misc/et200/Kconfig
```kconfig
config INPUT_ET200
        tristate "Chipone Touchscreen test"
        depends on SPI_MASTER
        help
          Say Y here if you have Chipone touch panel.

          If unsure, say N.

          To compile this driver as a module, choose M here: the
          module will be called focal_spi_ts.
```

## kernel/kernel4.14/drivers/soc/sprd/modem/secureboot/Kconfig
```kconfig
config SPRD_SECBOOT
	tristate "sprd secureboot for verification of modem images"
	default n
	help
	  sprd secureboot for verification of modem images
```

## kernel/kernel4.14/sound/soc/sprd/codec/sprd/as6480/Kconfig
```kconfig
config SND_SOC_AS6480
	tristate "SoC Audio for awinic AS6480 Switch"
	depends on I2C
	help
	  This option enables support for AS6480 Switch.
```

## kernel/kernel4.14/sound/soc/sprd/codec/sprd/aw87519_l/Kconfig
```kconfig
config SND_SOC_AW87XX_IIC_PA
	tristate "Sprd Smart PA AW87519"
	depends on I2C
	help
	  If AW87519 smart pa is needed, set this to Y or M, else N.
```

## kernel/kernel4.14/sound/soc/sprd/codec/sprd/ocp96011/Kconfig
```kconfig
config SND_SOC_OCP96011
	tristate "SoC Audio for awinic OCP96011 Switch"
	depends on I2C
	help
	  This option enables support for OCP96011 Switch.
```

## modules/input/touchscreen/goodix_ts/Kconfig
```kconfig
#
# Goodix touchscreen driver configuration
#
menuconfig TOUCHSCREEN_GOODIX_GT738X
	bool "Goodix GT738x touchscreen"
	depends on I2C
	default y
	help
	  Say Y here if you have a Goodix GT738x touch controller
	  to your system.

	  If unsure, say N.

if TOUCHSCREEN_GOODIX_GT738X

config TOUCHSCREEN_GOODIX_GT738X_UPDATE
	tristate "Goodix GT738x firmware update module"
	default y
	help
	  Say Y here to enable support for doing firmware update.

	  If unsure, say N.

	  To compile this driver as a module, choose M here.

config TOUCHSCREEN_GOODIX_GT738X_GESTURE
	tristate "Goodix GT738x gesture wakeup feature"
	default n
	help
	  Say Y here to enable support for gesture wakeup feature..

	  If unsure, say N.

	  To compile this driver as a module, choose M here.

config TOUCHSCREEN_GOODIX_GT738X_TOOLS
	tristate "Goodix touch tools support"
	default n
	help
	  Say Y here to enable debug tools.

	  If unsure, say N.

	  To compile this driver as a module, choose M here.

endif


5 obj-$(CONFIG_TOUCHSCREEN_GOODIX_GT738X)           += goodix_core.o
6 goodix_core-y                   := goodix_ts_i2c.o goodix_ts_core.o goodix_cfg_bin.o
7 obj-$(CONFIG_TOUCHSCREEN_GOODIX_GT738X_UPDATE)    += goodix_gt738x_update.o
8 obj-$(CONFIG_TOUCHSCREEN_GOODIX_GT738X_GESTURE)   += goodix_ts_gesture.o
9 obj-$(CONFIG_TOUCHSCREEN_GOODIX_GT738X_TOOLS)     += goodix_ts_tools.o
```
